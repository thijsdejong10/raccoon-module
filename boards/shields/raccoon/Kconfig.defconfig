## boards/shields/raccoon/Kconfig.defconfig
```kconfig
if SHIELD_RACCOON_LEFT

config ZMK_KEYBOARD_NAME
    default "Raccoon"

config ZMK_SPLIT_ROLE_CENTRAL
    default y

endif

if SHIELD_RACCOON_LEFT || SHIELD_RACCOON_RIGHT

config ZMK_SPLIT
    default y

endif
```

## boards/shields/raccoon/Kconfig.shield
```kconfig
config SHIELD_RACCOON_LEFT
    def_bool $(shields_list_contains,raccoon_left)

config SHIELD_RACCOON_RIGHT
    def_bool $(shields_list_contains,raccoon_right)
```
